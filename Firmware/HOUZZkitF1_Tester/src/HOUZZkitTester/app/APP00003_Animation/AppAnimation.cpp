#include "AppAnimation.h"
#include "HOUZZkitTester/SDTConfig.h"
#include "HOUZZkitTester/SDTIconLib.h"
#ifndef TARGET_OS_MAC
#include <SPIFFS.h>
#endif
const uint8_t default_img[] PROGMEM = 
{
    0x47,0x49,0x46,0x38,0x39,0x61,0x20,0x00,0x08,0x00,0xf3,0x01,0x00,0xff,0x00,0x00, 
0xae,0xff,0x02,0xda,0x00,0xb3,0x00,0xff,0x00,0xfe,0xff,0x04,0x00,0xff,0xaa,0x01, 
0xaf,0xff,0xff,0xaa,0x02,0xff,0xff,0x00,0x00,0x00,0x00,0x00,0x00,0x00,0x00,0x00, 
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0x00,0x04,0x02,0x50,0x44,0x00,0x3
};


NS_DT_BEGIN
AppDataAnimation::AppDataAnimation()
:bufferRefresh(false)
,imgType("")
,width(0)
,height(0)
{
    appAlias = "自定义动画";
    canPlay = true;
    openPlay = true;
    isActive = true;
}

bool AppDataAnimation::subEncode(SDTData::DataSourceType type)
{
    pushString8(imgType.c_str());
    popUint8(width);
    popUint8(height);
//    bool res = setBuffer(imageBuffer, imageSize);
//    return res;
    return true;
}
 
bool AppDataAnimation::subDecode(SDTData::DataSourceType type)
{
    // LOG("AppDataAnimation::subDecode");
    imgType = popString8().c_str();
    width = popUint8();
    height = popUint8();
    // LOG_STR(imgType);
    // LOG_INT(width);
    // LOG_INT(height);
    //添加测试数据
    if (type == SDTData::DataSourceType::Net) {
        const uint8_t *buffer = nullptr;
        uint16_t size = 0;

        popBuffer16(&buffer, &size);
        // LOG_INT(size);
        if (size>0)
        {
            this->saveImageBuffer(buffer, size);
            bufferRefresh = true;
        }
    }else
    {
        
    }
    return true;
}

AppDataAnimation::~AppDataAnimation()
{
    
}

bool AppDataAnimation::appAddInit()
{
    // LOG("AppDataAnimation::init");
    if (!isImageExist())
    {
        // LOG("!isImageExist");
        this->saveImageBuffer(default_img, sizeof(default_img));
    }
    return true;
}

uint8_t* AppDataAnimation::getImageBuffer(uint32_t *size)
{
    uint8_t* buffer = nullptr;
    String path(FILE_IMG_DATA);
    path += String(this->fileId());
    buffer = FileUtils::getInstance()->readDataFromPath(path.c_str(), size);
    return buffer;
}

bool AppDataAnimation::isImageExist()
{
    if(id>0)
    {
        String path(FILE_IMG_DATA);
        path += String(this->fileId());
        return FileUtils::getInstance()->isFileExist(path.c_str());
    }
    return false;
}

void AppDataAnimation::saveImageBuffer(const uint8_t* buffer,uint32_t size)
{
    if (id>0) {
        // LOG("AppDataAnimation::saveImageBuffer id > 0");
        String path(FILE_IMG_DATA);
        path += String(this->fileId());
        // LOG_STR(path);
        // LOG_INT(size);
        FileUtils::getInstance()->writeDataToPath(buffer,size, path.c_str());
    }
}

void AppDataAnimation::attachmentRemove()
{
    if (id>0) {
        String path(FILE_IMG_DATA);
        path += String(this->fileId());
        FileUtils::getInstance()->removeFile(path.c_str());
    }
}

String AppDataAnimation::imgPath()
{
    if (id>0) {
        String path(FILE_IMG_DATA);
        path += String(this->fileId());
        return path;
    }
    return "";
}

bool AppRequestAnimation::parseRequest(const String& res)
{
    return true;
}

void AppRequestAnimation::scheduleAction(float dt)
{
    
}


bool AppAnimation::init()
{
#ifndef TARGET_OS_MAC
    rootLayer = AppAnimationLayer::createWithApp(this,Size::ZERO);
    this->addChild(rootLayer);
#endif
    return true;
}

#ifndef TARGET_OS_MAC

File *cImgFile = nullptr;
SpriteCanvas *cCanvas = nullptr;
SpriteCanvas *cRenderCanvas = nullptr;

bool fileSeekCallback(unsigned long position) 
{
    return cImgFile->seek(position); 
}

unsigned long filePositionCallback(void) 
{ 
    return cImgFile->position(); 
}

int fileReadCallback(void) 
{ 
    return cImgFile->read(); 
}

int fileReadBlockCallback(void * buffer, int numberOfBytes) 
{ 
    return cImgFile->read((uint8_t*)buffer, numberOfBytes); 
}

void screenClearCallback(void) 
{
    // LOG("screenClearCallback");
    cCanvas->canvasReset();
}

void updateScreenCallback(void) 
{
    // LOG("updateScreenCallback");
    cRenderCanvas->copyBuffer(cCanvas->getBuffer(),cCanvas->width()*cCanvas->height());
}     

void drawPixelCallback(int16_t x, int16_t y, uint8_t red, uint8_t green, uint8_t blue) 
{
    // LOG("x:%d,y:%d,r:%d,g:%d,b:%d",x,y,red,green,blue);
    cCanvas->drawPixel(x,y,DTRGB(red,green,blue));
}


AppAnimationLayer::AppAnimationLayer()
{
    // LOG("AppAnimationLayer::AppAnimationLayer");
}

void AppAnimationLayer::onExit()
{
    AppLayerBase::onExit();
    // LOG("AppAnimationLayer::onExit");
    DT_SAFE_RELEASE(canvas);
    file.close();
    cImgFile = nullptr;
}

void AppAnimationLayer::onEnter()
{
    AppLayerBase::onEnter();
    cCanvas->canvasReset();
    cRenderCanvas->canvasReset();
    // LOG("AppAnimationLayer::onEnter");
    // LOG_STR(this->getData()->imgPath());
    file = SPIFFS.open(this->getData()->imgPath(), FILE_READ);
    if (!file) {
        // Serial.println(": Error opening GIF file");
    }else
    {
        // LOG("File Opened %d",file.size());
    }
    cImgFile = &file;

    delay(100);

    decoder.setDrawLineCallback(nullptr);
    decoder.setScreenClearCallback(screenClearCallback);
    decoder.setUpdateScreenCallback(updateScreenCallback);
    decoder.setDrawPixelCallback(drawPixelCallback);

    decoder.setFileSeekCallback(fileSeekCallback);
    decoder.setFilePositionCallback(filePositionCallback);
    decoder.setFileReadCallback(fileReadCallback);
    decoder.setFileReadBlockCallback(fileReadBlockCallback);

    decoder.startDecoding();
    this->scheduleUpdate();
}

AppAnimationLayer::~AppAnimationLayer()
{
    // LOG("AppAnimationLayer::~AppAnimationLayer");
    
}



bool AppAnimationLayer::initLayer()
{
    renderCanvas = SpriteCanvas::create(this->getContentSize());
    dot2d::CanvasSprite *sprite = dot2d::CanvasSprite::create(renderCanvas);
    this->addChild(sprite);

    canvas = SpriteCanvas::create(this->getContentSize());
    canvas->canvasReset();
    canvas->retain();

    cCanvas = canvas;
    cRenderCanvas = renderCanvas;

    // sprite = CanvasSprite::create(32,8);
    // globalSprite = sprite;
    // if (sprite) {
    //     this->addChild(sprite);
    //     dot2d::Vec2 pos(0,0);
    //     dot2d::Size screenSize = dot2d::Director::getInstance()->getCanvasSize();
    //     dot2d::Size contentSize = sprite->getContentSize();
    //     pos.x = (screenSize.width - contentSize.width) / 2;
    //     pos.y = (screenSize.height - contentSize.height) / 2;
    //     sprite->setPosition(pos);
    //     // sprite->setAutoSwitch(true);
    // }

    return true;
}

void AppAnimationLayer::customUpdate(float dt)
{
    decoder.decodeFrame();
}

void AppAnimationLayer::update(float dt)
{
    if (this->getData()->bufferRefresh)
    {
        file.close();
        file = SPIFFS.open(this->getData()->imgPath(), FILE_READ);
        cImgFile = &file;
        decoder.startDecoding();
        this->getData()->bufferRefresh = false;
    }
    decoder.decodeFrame();
}

#endif
NS_DT_END
