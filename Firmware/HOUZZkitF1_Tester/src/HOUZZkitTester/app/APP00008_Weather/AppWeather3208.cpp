#include "AppWeather3208.h"
#include "HOUZZkitTester/SDTIconLib.h"
NS_DT_BEGIN


const uint8_t icon_sunny[] PROGMEM =
{
    0x00,0x6b,
    0x44,0x47,0x46,0x11,0x08,0x08,0x84,0x00,
    0x00,0x00,0xff,0x3d,0x16,0xff,0xc9,0x2f,
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    0x23,0x00,0x96
};

const uint8_t icon_cloudy[] PROGMEM =
{
    0x00,0x2d,
    0x44,0x47,0x46,0x11,0x08,0x08,0x43,0x00,
    0x00,0x00,0x0a,0x7e,0xff,0xff,0x49,0x00,
    0xb1,0xff,0xf9,0x2c,0x00,0xc8,0x00,0x00,
    0x08,0x08,0x80,0x00,0x00,0xa0,0x02,0xa8,
    0x0a,0xaa,0x0a,0xaa,0x05,0xa8,0x15,0x60,
    0x55,0x50,0x55,0x54,0x96
};

const uint8_t icon_unknow[] PROGMEM =
{
    0x00,0x5b,
    0x44,0x47,0x46,0x11,0x08,0x08,0x42,0x00,
    0x00,0x00,0xff,0x0a,0x00,0xea,0xf4,0xff,
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    0x00,0x16,0x96
};

const uint8_t icon_overcast[] PROGMEM =
{
    0x00,0x2b,
    0x44,0x47,0x46,0x11,0x08,0x08,0x43,0x00,
    0x00,0x00,0x36,0x38,0x39,0xc4,0xc8,0xcb,
    0xea,0xef,0xf2,0x2c,0x00,0x3c,0x00,0x01,
    0x08,0x07,0x80,0x00,0x00,0xa0,0x02,0xa8,
    0x0a,0xaa,0x25,0xaa,0x15,0x40,0x55,0x50,
    0x55,0x54,0x96
};

const uint8_t icon_rainy[] PROGMEM =
{
    0x00,0x85,
    0x44,0x47,0x46,0x11,0x08,0x08,0x43,0x00,
    0x00,0x00,0x36,0x38,0x39,0xc4,0xc8,0xcb,
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    0xc3,0x03,0x00,0x00,0x96
};

const uint8_t icon_snowy[] PROGMEM =
{
    0x00,0x85,
    0x44,0x47,0x46,0x11,0x08,0x08,0x43,0x00,
    0x00,0x00,0x36,0x38,0x39,0xc4,0xc8,0xcb,
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    0xc3,0x03,0x00,0x00,0x96
};

const uint8_t icon_foggy[] PROGMEM =
{
    0x00,0x4f,
    0x44,0x47,0x46,0x11,0x08,0x08,0x89,0x00,
    0x00,0x00,0xff,0xff,0xff,0xb7,0xb7,0xb7,
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    0x33,0x33,0x33,0x33,0x33,0x33,0x96
};

const uint8_t icon_smog[] PROGMEM =
{
    0x00,0x4f,
    0x44,0x47,0x46,0x11,0x08,0x08,0x89,0x00,
    0x00,0x00,0xff,0xff,0xff,0xb7,0xb7,0xb7,
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    0x77,0x77,0x88,0x88,0x88,0x88,0x96
};


bool AppWeatherLayer3208::initLayer()
{
    _layerStyle = LayerStyleIconNum3208::create();
    _layerStyle->initWithData(icon_8_8_loading+2,GetUint16(icon_8_8_loading),this->getData(),this,48);
    this->addChild(_layerStyle);
    
    this->schedule(DT_SCHEDULE_SELECTOR(AppWeatherLayer3208::customUpdate),5);
    return true;
}

void AppWeatherLayer3208::customUpdate(float dt)
{
    _showType++;
    if (_showType>3)
    {
        _showType = 0;
    }
}

void AppWeatherLayer3208::printAction(SpriteCanvas* canvas)
{
    if (_preWeatherType != this->getData()->weatherType) {
       switch (this->getData()->weatherType) {
            case AppDataWeather::WeatherType::Sunny:
                _layerStyle->setIcon(icon_sunny+2, GetUint16(icon_sunny));
                break;
            case AppDataWeather::WeatherType::Overcast:
                _layerStyle->setIcon(icon_overcast+2, GetUint16(icon_overcast));
                break;
            case AppDataWeather::WeatherType::Cloudy:
                _layerStyle->setIcon(icon_cloudy+2, GetUint16(icon_cloudy));
                break;
            case AppDataWeather::WeatherType::Rainy:
                _layerStyle->setIcon(icon_rainy+2, GetUint16(icon_rainy));
                break;
            case AppDataWeather::WeatherType::Snowy:
                _layerStyle->setIcon(icon_snowy+2, GetUint16(icon_snowy));
                break;
            case AppDataWeather::WeatherType::Foggy:
                _layerStyle->setIcon(icon_foggy+2, GetUint16(icon_foggy));
                break;
            case AppDataWeather::WeatherType::Smog:
                _layerStyle->setIcon(icon_smog+2, GetUint16(icon_smog));
                break;
            default:
                _layerStyle->setIcon(icon_sunny+2, GetUint16(icon_sunny));
                break;
        }
        _preWeatherType = this->getData()->weatherType;
    }
    if (_preShowType != _showType)
    {
        _layerStyle->setContentOffsetX(0);
        _preShowType = _showType;
    }
    switch (_showType)
    {
    case 0:
        canvas->printf("%d C",this->getData()->temperature);
        break;
    case 1:
        canvas->printf("%d %%",this->getData()->humidity);
        break;
    case 2:
        canvas->printf("%.1f kPa",this->getData()->airPressure/10.0);
        break;
    case 3:
        canvas->printf("%d API",this->getData()->aqi);
        break;
    default:
        break;
    }
}

NS_DT_END
