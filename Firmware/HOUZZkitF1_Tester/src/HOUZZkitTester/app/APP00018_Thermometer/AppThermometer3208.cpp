#include "AppThermometer3208.h"
#include "HOUZZkitTester/device/SDTDevice.h"
NS_DT_BEGIN


const uint8_t icon_temperature[] PROGMEM =
{
    0x00,0x7a,
0x44,0x47,0x46,0x11,0x08,0x08,0x42,0x00,
0x00,0x00,0xff,0xff,0xff,0xff,0x00,0x00,
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0xa0,0x96
};

const uint8_t icon_humidity[] PROGMEM =
{
    0x00,0x3c,
0x44,0x47,0x46,0x11,0x08,0x08,0x84,0x00,
0x00,0x00,0xf8,0xf4,0xff,0x3c,0x70,0xff,
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0x01,0x11,0x00,0x96
};


bool AppThermometerLayer3208::initLayer()
{
    _layerStyle = LayerStyleIconNum3208::create();
    _layerStyle->initWithData(icon_temperature+2,GetUint16(icon_temperature),this->getData(),this,48);
    this->addChild(_layerStyle);

    this->schedule(DT_SCHEDULE_SELECTOR(AppThermometerLayer3208::customUpdate),5);
    return true;
}

void AppThermometerLayer3208::customUpdate(float dt)
{
    _temAndHumSwitch = !_temAndHumSwitch;
    
}

void AppThermometerLayer3208::printAction(SpriteCanvas* canvas)
{
    if (_preTemAndHumSwitch != _temAndHumSwitch)
    {
        if (_temAndHumSwitch)
        {
            _layerStyle->setIcon(icon_temperature+2, GetUint16(icon_temperature));
        }else
        {
            _layerStyle->setIcon(icon_humidity+2, GetUint16(icon_humidity));
        }
        _preTemAndHumSwitch = _temAndHumSwitch;
    }
#ifndef TARGET_OS_MAC
    DEVICE.sht.UpdateData();
    if (_temAndHumSwitch)
    {
        canvas->printf("%.1f C",DEVICE.sht.GetTemperature());
    }else
    {
        canvas->printf("%.1f %%",DEVICE.sht.GetRelHumidity());
    }
#else
    if (_temAndHumSwitch)
    {
        canvas->printf("%.1f C",55.0);
    }else
    {
        canvas->printf("%.1f %%",99.0);
    }
#endif
}

NS_DT_END
